## CMakeLists.txt
```
cmake_minimum_required(VERSION 3.13.1)

include($ENV{ZEPHYR_BASE}/cmake/app/boilerplate.cmake NO_POLICY_SCOPE)
project(bdsk)

zephyr_include_directories_ifdef(CONFIG_BOARD_BBC_MICROBIT
   $ENV{ZEPHYR_BASE}/boards/arm/bbc_microbit)

FILE(GLOB app_sources src/*.c)
target_sources(app PRIVATE
  ${app_sources}
  src/services/link_loss.c
  src/services/immediate_alert.c
  src/services/tx_power.c
  src/services/proximity_monitoring.c
  src/services/health_thermometer.c
  src/hardware/lcd/lcd.c
  src/hardware/led/led.c
  src/hardware/thermistor/thermistor.c
  src/hardware/buzzer/buzzer.c
  )

zephyr_library_include_directories(src)
```

## prj.conf
```kconfig
CONFIG_BT=y
CONFIG_BT_DEBUG_LOG=y
CONFIG_BT_SMP=n
CONFIG_BT_PERIPHERAL=y
CONFIG_BT_GATT_DIS=y
CONFIG_BT_GATT_DIS_PNP=n
CONFIG_BT_DEVICE_NAME="BDSK"
CONFIG_BT_RX_STACK_SIZE=1536

CONFIG_GPIO=y
CONFIG_PWM=y
CONFIG_SERIAL=y
CONFIG_CONSOLE=n

CONFIG_ADC=y
CONFIG_ADC_NRFX_ADC=y
CONFIG_ADC_ASYNC=n
CONFIG_ADC_0=y
CONFIG_ADC_NRFX_ADC_CHANNEL_COUNT=3
```

## bbc_microbit.overlay
```dts
&uart0 {
   status = "ok";
   compatible = "nordic,nrf-uart";
   current-speed = <9600>;
   tx-pin = <3>;
   rx-pin = <16>;
};
&adc {
	status ="ok";
};
```

## src/main.c
```c
/* main.c - Application main entry point */

/*
 * Copyright (c) 2015-2016 Intel Corporation
 *
 * SPDX-License-Identifier: Apache-2.0
 */

#include <zephyr/types.h>
#include <stddef.h>
#include <string.h>
#include <errno.h>
#include <misc/printk.h>
#include <misc/byteorder.h>
#include <zephyr.h>
#include <board.h>
#include <device.h>

#include <bluetooth/bluetooth.h>
#include <bluetooth/hci.h>
#include <bluetooth/conn.h>
#include <bluetooth/uuid.h>
#include <bluetooth/gatt.h>

#include <hardware/lcd/lcd.h>
#include <hardware/led/led.h>
#include <hardware/buzzer/buzzer.h>
#include <hardware/thermistor/thermistor.h>
#include <services/link_loss.h>
#include <services/immediate_alert.h>
#include <services/tx_power.h>
#include <services/proximity_monitoring.h>
#include <services/health_thermometer.h>

#define DEVICE_NAME CONFIG_BT_DEVICE_NAME
#define DEVICE_NAME_LEN (sizeof(DEVICE_NAME) - 1)

struct bt_conn *default_conn;
int is_sampling = 0;

struct k_delayed_work temperature_timer;

static const struct bt_data ad[] = {
		BT_DATA_BYTES(BT_DATA_FLAGS, (BT_LE_AD_GENERAL | BT_LE_AD_NO_BREDR)),
		BT_DATA(BT_DATA_NAME_COMPLETE, DEVICE_NAME, DEVICE_NAME_LEN),
};

static void sample_temperature()
{
	if (is_sampling == 1 && get_temperature_subscribed() == 1) {
		int celsius = (int)readTemperature();
		s64_t now = k_uptime_get();
		printk("%lld> temperature: %d degrees C\n", now, celsius);
		indicate_temperature_measurement_celsius(celsius);

		// and again in one second from now
		if (is_sampling == 1) {
			k_delayed_work_submit(&temperature_timer, K_SECONDS(1));
		}
	}
}

static void start_sampling_temperature()
{
	printk("starting temperature sampling\n");
	is_sampling = 1;
    k_delayed_work_init(&temperature_timer, sample_temperature);
	k_delayed_work_submit(&temperature_timer, K_SECONDS(1));
}

static void stop_sampling_temperature()
{
	printk("stopping temperature sampling\n");
	is_sampling = 0;
}

static void connected(struct bt_conn *conn, u8_t err)
{
	if (err)
	{
		printk("Connection failed (err %u)\n", err);
	}
	else
	{
		default_conn = bt_conn_ref(conn);
		set_connection(conn);
		write_string("connected       ", 16, 0, 0);
	}
}

static void disconnected(struct bt_conn *conn, u8_t reason)
{
	printk("Disconnected (reason %u)\n", reason);
	printk("Disconnected (alert_level %d)\n", get_link_loss_alert_level());

	write_string("disconnected    ", 16, 0, 0);
	set_led_states(false, false, false);

	stop_sampling_temperature();

	if (get_link_loss_alert_level() > 0)
	{
		// handle link loss per the alert level
		flash(true, true, true, get_link_loss_alert_level() * 15);
		buzz(get_link_loss_alert_level() * 15);
	}

	if (default_conn)
	{
		bt_conn_unref(default_conn);
		default_conn = NULL;
	}
}

static struct bt_conn_cb conn_callbacks = {
		.connected = connected,
		.disconnected = disconnected,
};

static void bt_ready(int err)
{
	if (err)
	{
		printk("Bluetooth init failed (err %d)\n", err);
		return;
	}

	link_loss_init();
	immediate_alert_init();
	tx_power_init();
    void (*f_ptr)() = &start_sampling_temperature; 
	health_thermometer_init(f_ptr);
	proximity_monitoring_init();

	err = bt_le_adv_start(BT_LE_ADV_CONN, ad, ARRAY_SIZE(ad), NULL, 0);
	if (err)
	{
		printk("Advertising failed to start (err %d)\n", err);
		return;
	}

	printk("Advertising successfully started\n");
}

static void io_test()
{
	flash(true, false, false, 2);
	k_sleep(2000);
	flash(false, true, false, 2);
	k_sleep(2000);
	flash(false, false, true, 2);
	k_sleep(2000);
	buzz(3);
	backlight();
	clear_lcd();
	write_string("hello", 5, 0, 0);
	write_string("martin", 6, 1, 0);
}

void main(void)
{

	printk("starting\n");

	int err;

	err = bt_enable(bt_ready);
	if (err)
	{
		return;
	}

	bt_conn_cb_register(&conn_callbacks);

	lcd_init();
	led_init();
	buzzer_init();
	thermistor_init();

	clear_lcd();
	write_string("ready", 5, 0, 0);

	// io_test();
}
```
